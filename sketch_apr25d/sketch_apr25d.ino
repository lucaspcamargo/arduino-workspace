#define TWI_FREQ 400000L

#include <Wire.h>
#include <SeeedGrayOLED.h>

#include <avr/pgmspace.h>
static const unsigned char titlescreen [] PROGMEM = {
  0xFF, 0xFF, 0xFF, 0xFF, 0xFF, 0xFF, 0xFF, 0xFF, 0xFF, 0xFF, 0xFF, 0xFF, 0x80, 0x00, 0x00, 0x00,
  0x00, 0x00, 0x00, 0x00, 0x00, 0x00, 0x00, 0x01, 0x80, 0x00, 0x00, 0x00, 0x00, 0x00, 0x00, 0x00,
  0x00, 0x00, 0x00, 0x01, 0x80, 0x00, 0x00, 0x00, 0x00, 0x00, 0x00, 0x00, 0x00, 0x00, 0x00, 0x01,
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  0x00, 0x00, 0x00, 0x01, 0xFF, 0xFF, 0xFF, 0xFF, 0xFF, 0xFF, 0xFF, 0xFF, 0xFF, 0xFF, 0xFF, 0xFF
};
static const unsigned char qr [] PROGMEM = {
  0x00, 0x00, 0x00, 0x00, 0x00, 0x00, 0x00, 0x00, 0x00, 0x00, 0x00, 0x00, 0x7F, 0xFF, 0xFF, 0xFF,
  0xFF, 0xFF, 0xFF, 0xFF, 0xFF, 0xFF, 0xFF, 0xFE, 0x40, 0x00, 0x00, 0x00, 0x00, 0x00, 0x00, 0x00,
  0x00, 0x00, 0x00, 0x02, 0x5F, 0xFF, 0xFF, 0xFF, 0xFF, 0xFF, 0xFF, 0xFF, 0xFF, 0xFF, 0xFF, 0xFA,
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  0xFF, 0xFF, 0xFF, 0xFE, 0x00, 0x00, 0x00, 0x00, 0x00, 0x00, 0x00, 0x00, 0x00, 0x00, 0x00, 0x00
};

#define RxD 10
#define TxD 11

#define DEBUG_ENABLED  1
#define BLE  Serial1

#define B_W	24
#define B_H	24


char	brd[B_W][B_H], i, j;
char buf[B_W][B_H];
bool mute;

void initBoard () {
  char	i, j;

  for (i = 0; i < B_W; i++) for (j = 0; j < B_H; j++)
      brd[i][j] = !random(0, 3);
}

void zeroBoard () {
  char	i, j;

  for (i = 0; i < B_W; i++) for (j = 0; j < B_H; j++)
      brd[i][j] = 0;
}

char xadd (char i, char a) {
  i += a;
  while (i < 0) i += B_W;
  while (i >= B_W) i -= B_W;
  return i;
}

char yadd (char i, char a) {
  i += a;
  while (i < 0) i += B_H;
  while (i >= B_H) i -= B_H;
  return i;
}

char countAdj ( char i, char j) {
  char	k, l, count;

  count = 0;

  /* go around the cell */

  for (k = -1; k <= 1; k++) for (l = -1; l <= 1; l++)

      /* only count if at least one of k,l isn't zero */

      if (k || l)
        if (brd[xadd(i, k)][yadd(j, l)]) count++;
  return count;
}

void play () {

  char	i, j, a;

  for (i = 0; i < B_W; i++) for (j = 0; j < B_H; j++) {
      a = countAdj (i, j);
      if (a == 2) buf[i][j] = brd[i][j];
      if (a == 3) buf[i][j] = 1;
      if (a < 2) buf[i][j] = 0;
      if (a > 3) buf[i][j] = 0;
    }

  /* copy the new board back charo the old board */

  for (i = 0; i < B_W; i++) for (j = 0; j < B_H; j++) {
      brd[i][j] = buf[i][j];
    }
}

void msg(const char *m)
{
  SeeedGrayOled.clearDisplay();
  SeeedGrayOled.setTextXY(6, 6 - strlen(m) / 2);
  SeeedGrayOled.putString(m);

}

void setup()
{
  randomSeed(analogRead(2)^analogRead(3)^analogRead(4));
  pinMode(8, OUTPUT);
  mute = false;

  Wire.begin();
  SeeedGrayOled.init();             //initialize SEEED OLED display
  SeeedGrayOled.setNormalDisplay(); //Set Normal Display Mode
  SeeedGrayOled.setVerticalMode();  // Set to vertical mode for displaying text
  SeeedGrayOled.drawBitmap(titlescreen, 96 * 96 / 8);

  tone(8, 311, 500);
  Serial.begin(9600);
  pinMode(RxD, INPUT);
  pinMode(TxD, OUTPUT);

  setupBleConnection();
  showInstructions();

  initBoard();

  pinMode(LED2, OUTPUT);
  digitalWrite(LED2, HIGH);

  //play();

  msg("Done");

}

void loop()
{
  char recvChar = 0;

  while (Serial.available()) { //check if there's any data sent from the local serial terminal, you can add the other applications here
    recvChar  = Serial.read();
    BLE.print(recvChar);
  }
  while (BLE.available()) { //check if there's any data sent from the remote BLE
    recvChar = BLE.read();
    Serial.print(recvChar);
  }

#define CLRTONE if(!mute)tone(8, 277, 1700)
#define CLRSONG if(!mute){delay(200); tone(8, 349, 400); delay(500);  tone(8, 294, 200); delay(200); tone(8, 493, 200); delay(1500);}

  if (recvChar == 'r') {
    CLRTONE;
    msg("Randomize!");
    CLRSONG;
    initBoard();
  }
  else if (recvChar == 'p') {
    CLRTONE;
    msg("R-Pentomino");
    CLRSONG;
    zeroBoard();
    brd[10][9] = 1;
    brd[10][10] = 1;
    brd[10][11] = 1;
    brd[11][9] = 1;
    brd[9][10] = 1;
  }
  else if (recvChar == 'g') {
    CLRTONE;
    msg("Glider!");
    CLRSONG;
    zeroBoard();
    brd[10][9] = 1;
    brd[10][10] = 1;
    brd[10][11] = 1;
    brd[8][10] = 1;
    brd[9][11] = 1;
  }
  else if (recvChar == 'l') {
    CLRTONE;
    msg("LWSS");
    CLRSONG;
    zeroBoard();
    brd[8][8] = 1;
    brd[11][8] = 1;
    brd[12][9] = 1;
    brd[12][10] = 1;
    brd[12][11] = 1;
    brd[11][11] = 1;
    brd[10][11] = 1;
    brd[9][11] = 1;
    brd[8][10] = 1;
  } if (recvChar == 'm') {
    mute = !mute;
  }

  // draw board

  SeeedGrayOled.setHorizontalMode();

#define _SD_ SeeedGrayOled.sendData
#define pat1 0x00
#define pat2 0x00

  for (j = 0; j < B_H; j++) {
    for (i = 0; i < B_W; i++)  {
      if (brd[i][j])
      {
        _SD_(0xFE);
        _SD_(0xDC);
      }
      else
      {
        _SD_(pat2);
        _SD_(pat2);
      }

    }
    for (i = 0; i < B_W; i++)  {
      if (brd[i][j])
      {
        _SD_(0xED);
        _SD_(0xC9);
      }
      else
      {
        _SD_(pat1);
        _SD_(pat1);
      }
    }
    for (i = 0; i < B_W; i++)  {
      if (brd[i][j])
      {
        _SD_(0xDC);
        _SD_(0xB8);
      }
      else
      {
        _SD_(pat2);
        _SD_(pat2);
      }
    }
    for (i = 0; i < B_W; i++)  {
      if (brd[i][j])
      {
        _SD_(0xA9);
        _SD_(0x87);
      }
      else
      {
        _SD_(pat1);
        _SD_(pat1);
      }
    }
  }

  SeeedGrayOled.setVerticalMode();  // Set to vertical mode for displaying text

  play();
  if (!mute)tone(8, 415, 150);

}


void setupBleConnection()
{
  BLE.begin(9600); //Set BLE BaudRate to default baud rate 9600
  delay(750);
  tone(8, 370, 500);
  BLE.print("AT+ROLE0"); //set the bluetooth name as a slaver
  delay(750);
  BLE.print("AT+SAVE1");  //don't save the connect information
  tone(8, 494, 500);
  SeeedGrayOled.drawBitmap(qr, 96 * 96 / 8);
  BLE.print("AT+NAMEGoL");  //don't save the connect information
  delay(1500);
}


void showInstructions()
{
  SeeedGrayOled.clearDisplay();
  SeeedGrayOled.setVerticalMode();
  SeeedGrayOled.setTextXY(0, 0);
  SeeedGrayOled.putString("COMMANDS:");
  SeeedGrayOled.setTextXY(2, 0);
  SeeedGrayOled.putString("[r]andomize");
  SeeedGrayOled.setTextXY(3, 0);
  SeeedGrayOled.putString("[p]entomino");
  SeeedGrayOled.setTextXY(4, 0);
  SeeedGrayOled.putString("[g]lider");
  SeeedGrayOled.setTextXY(5, 0);
  SeeedGrayOled.putString("[l]wss");
  SeeedGrayOled.setTextXY(6, 0);
  SeeedGrayOled.putString("[m]ute");
  SeeedGrayOled.setTextXY(8, 0);
  SeeedGrayOled.putString("Send char by");
  SeeedGrayOled.setTextXY(9, 0);
  SeeedGrayOled.putString("serial to");
  SeeedGrayOled.setTextXY(10, 0);
  SeeedGrayOled.putString("execute :)");
  delay(4000);
  CLRSONG;

}
